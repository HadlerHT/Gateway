## main/Kconfig.projbuild
```kconfig
menu "WiFi Configuration"

    config WIFI_SSID
        string "WiFi SSID"
        default "your_ssid"
        help
            Enter your WiFi SSID.

    config WIFI_PASSWORD
        string "WiFi Password"
        default "your_password"
        help
            Enter your WiFi password.

endmenu
```
